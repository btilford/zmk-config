
#include <behaviors.dtsi>
#include <behaviors/num_word.dtsi> // Requires zmk-auto-layer module.
#include <behaviors/unicode.dtsi> // Requires zmk-unicode module.
#include <zmk-helpers/helper.h> // Requires zmk-helpers module.
#include <dt-bindings/zmk/keys.h>
#ifdef CONFIG_WIRELESS
  #include <dt-bindings/zmk/bt.h>
  #include <dt-bindings/zmk/outputs.h>
  #define _BT_SEL_KEYS_                                                        \
      &bt BT_SEL 0 &bt BT_SEL 1 &bt BT_SEL 2 &bt BT_SEL 3 &bt BT_CLR
#else
  #define _BT_SEL_KEYS_ &trans &trans &trans &trans &trans
#endif

// Layers
#define BASE 0
#define SYM 1
#define NUMPD 2
#define MOTION 3
#define TEXT 4
#define MEDIA 5
// NOTE: these indices are positional — they must match the order the
// ZMK_BASE_LAYER blocks appear below. The old Desktop layer (6) was deleted
// (unreachable: zero activations), so everything after it shifted down one.
#define FKEYS 6
#define MOUSE 7
#define MOUSE_SNIPE 8
#define MOUSE_HYPR 9
#define BTOOTH 10


#define XXX &none
#define ___ &trans

/* Global defaults */

#define QUICK_TAP_MS 193
#define TAPPING_TERM_MS 200

&sk {
  release-after-ms = <1500>;
  quick-release;
};

&sl { // Allow sticky mods to chord across sticky layers.
  ignore-modifiers;
};

&lt {
  flavor = "balanced";
  tapping-term-ms = <TAPPING_TERM_MS>;
  quick-tap-ms = <QUICK_TAP_MS>;
};

/* Homerow mods */
#define KEYS_L LT0 LT1 LT2 LT3 LT4 LT5 LM0 LM1 LM2 LM3 LM4 LM5 LB0 LB1 LB2 LB3 LB4 LB5
#define KEYS_R RT0 RT1 RT2 RT3 RT4 RT5 RM0 RM1 RM2 RM3 RM4 RM5 RB0 RB1 RB2 RB3 RB4 RB5
#ifndef LH2
  #define THUMBS LH1 LH0 RH0 RH1         // Thumbs on 34 keys.
#else
  #define THUMBS LH2 LH1 LH0 RH0 RH1 RH2 // Thumbs on 36+ keys.
#endif

#define MAKE_HRM(NAME, HOLD, TAP, TRIGGER_POS)                                 \
  ZMK_HOLD_TAP(NAME, bindings = <HOLD>, <TAP>; flavor = "balanced";            \
               tapping-term-ms = <TAPPING_TERM_MS>; quick-tap-ms = <QUICK_TAP_MS>;         \
               require-prior-idle-ms = <150>; hold-trigger-on-release;         \
               hold-trigger-key-positions = <TRIGGER_POS>;)

// Positional hold-taps: a hold only engages if the *next* key is one of these.
// Cross-hand is the point — a left-hand mod is triggered by right-hand keys.
// These were previously wired same-hand (hml->KEYS_L, hmr->KEYS_R), which cost
// the positional shortcut: a fast cross-hand roll inside the tapping term
// resolved to tap, so cross-hand mods had to be waited out at full term.
//
// SYM puts F1-F12 across the whole top row, and Ctrl+F4 is same-hand, so the
// opposite hand's top row alone is not enough — both top rows are included.
// Each hand adds only its OWN top row, so there are no duplicate positions.
// require-prior-idle-ms = 150 keeps this from reintroducing same-hand misfires
// mid-word: a roll like s->w has no preceding idle, so the hold is ineligible.
#define TOP_L LT0 LT1 LT2 LT3 LT4 LT5
#define TOP_R RT0 RT1 RT2 RT3 RT4 RT5
MAKE_HRM(hml, &kp, &kp, KEYS_R TOP_L THUMBS) // Left-hand HRMs.
MAKE_HRM(hmr, &kp, &kp, KEYS_L TOP_R THUMBS) // Right-hand HRMs.

// Hack: Make HRM combos tap-only (cf, ZMK issue #544).
#define ZMK_COMBO_8(NAME, TAP, POS, LAYERS, COMBO_MS, IDLE_MS, HOLD, SIDE)     \
  MAKE_HRM(hm_combo_##NAME, &kp, TAP, SIDE THUMBS)                             \
  ZMK_COMBO_6(NAME, &hm_combo_##NAME HOLD 0, POS, LAYERS, COMBO_MS, IDLE_MS)

/* Combos, leader key sequences, mouse emulation */

#include "combos.dtsi" // Must be sourced after HRM-combo hack.
#include "leader.dtsi"
#include "mouse.dtsi"

/* Nav cluster */

// Trigger tap-action on all interrupts.
#define MT_CORE                                                                \
  flavor = "tap-preferred";                                                    \
  tapping-term-ms = <220>;                                                     \
  quick-tap-ms = <220>;                                                        \
  hold-trigger-key-positions = <0>;

&mt { MT_CORE };

ZMK_HOLD_TAP(mt_home, bindings = <&masked_home>, <&kp>; MT_CORE)
ZMK_HOLD_TAP(mt_end, bindings = <&masked_end>, <&kp>; MT_CORE)

#define NAV_LEFT  &mt_home 0   LEFT  // Tap: left  | Long-tap: start of line.
#define NAV_RIGHT &mt_end 0    RIGHT // Tap: right | Long-tap: end   of line.
#define NAV_UP    &mt LC(HOME) UP    // Tap: up    | Long-tap: start of doc.
#define NAV_DOWN  &mt LC(END)  DOWN  // Tap: down  | Long-tap: end   of doc.
#define NAV_BSPC  &mt LC(BSPC) BSPC  // Tap: bspc  | Long-tap: delete word bwd.
#define NAV_DEL   &mt LC(DEL)  DEL   // Tap: del   | Long-tap: delete word fwd.

// Mask CTRL on left/right hold to avoid accidental jumps to start/end of doc.
#define MASK_MODS(NAME, MODS, BINDING)                                         \
  ZMK_MOD_MORPH(NAME, bindings = <BINDING>, <BINDING>; mods = <MODS>;)

MASK_MODS(masked_home, (MOD_LCTL), &kp HOME)
MASK_MODS(masked_end,  (MOD_LCTL), &kp END)

/* Magic-shift & auto-layers */

// Tap: repeat after alpha, else sticky-shift |
// Shift + tap/ double-tap: caps-word | Hold: shift.
#define MAGIC_SHIFT &magic_shift LSHFT 0
ZMK_HOLD_TAP(magic_shift, bindings = <&kp>, <&magic_shift_tap>;
             flavor = "balanced"; tapping-term-ms = <200>;
             quick-tap-ms = <QUICK_TAP_MS>;)
ZMK_MOD_MORPH(magic_shift_tap, bindings = <&shift_repeat>, <&caps_word>;
              mods = <(MOD_LSFT)>;)
ZMK_ADAPTIVE_KEY(
    shift_repeat, bindings = <&sk LSHFT>;
    repeat {
      trigger-keys = <A B C D E F G H I J K L M N O P Q R S T U V W X Y Z>;
      bindings = <&key_repeat>;
      max-prior-idle-ms = <1200>;
      strict-modifiers;
    };)
&caps_word { // Mods deactivate caps-word, requires PR #1451. [TODO: rebase]
  /delete-property/ ignore-modifiers;

  continue-list = <UNDERSCORE MINUS DELETE BACKSPACE>;
};

// Tap: num-word | double-tap: sticky num-layer | Hold: num-layer.
#define SMART_NUM &smart_num NUMPD 0
ZMK_HOLD_TAP(smart_num, bindings = <&mo>, <&num_dance>; flavor = "balanced";
             tapping-term-ms = <200>; quick-tap-ms = <QUICK_TAP_MS>;)
ZMK_TAP_DANCE(num_dance, bindings = <&num_word NUMPD>, <&sl NUMPD>;
              tapping-term-ms = <200>;)

// Smart-mouse, requires tri-state module.
ZMK_TRI_STATE(
    smart_mouse, bindings = <&tog MOUSE>, <&none>, <&tog MOUSE>;
    ignored-key-positions =
        <LM1 LM2 LM3 LT2 LH0 LH1 RT1 RT2 RT3 RM0 RM1 RM2 RM3 RM4 RH0 RH1>;
    ignored-layers = <MOUSE MOTION FKEYS>;)

/* Custom behaviors */

// Alt+Tab swapper, requires tri-state module.
ZMK_TRI_STATE(swapper, bindings = <&kt LALT>, <&kp TAB>, <&kt LALT>;
              ignored-key-positions = <LT2 RT2 RM1 RM2 RM3>;)

// Define mod-morph with a *single* mod trigger for less repetition.
#define SIMPLE_MORPH(NAME, MOD, BINDING1, BINDING2)                            \
  ZMK_MOD_MORPH(NAME, mods = <(MOD_L##MOD | MOD_R##MOD)>;                      \
                bindings = <BINDING1>, <BINDING2>;)

// Tap: comma | Shift + tap: semicolon | Ctrl + shift + tap: <.
SIMPLE_MORPH(comma_morph, SFT, &kp COMMA, &comma_inner_morph)
SIMPLE_MORPH(comma_inner_morph, CTL, &kp SEMICOLON, &kp LESS_THAN)

// Tap: dot | Shift + tap: colon | Ctrl + shift + tap: >.
SIMPLE_MORPH(dot_morph, SFT, &kp DOT, &dot_inner_morph)
SIMPLE_MORPH(dot_inner_morph, CTL, &kp COLON, &kp GREATER_THAN)

// Tap: qmark | Shift + tap: excl.
SIMPLE_MORPH(qexcl, SFT, &kp QMARK, &kp EXCL)

// Tap: left/right parenthesis | Shft + tap: less-than/greater-than.
SIMPLE_MORPH(lpar_lt, SFT, &kp LPAR, &kp LT)
SIMPLE_MORPH(rpar_gt, SFT, &kp RPAR, &kp GT)

// Tap: space | Shift + tap: dot -> space -> sticky shift | Hold: nav layer.
ZMK_HOLD_TAP(lt_spc, bindings = <&mo>, <&spc_morph>; flavor = "balanced";
             tapping-term-ms = <200>; quick-tap-ms = <QUICK_TAP_MS>;)
SIMPLE_MORPH(spc_morph, SFT, &kp SPACE, &dot_spc)
ZMK_MACRO(dot_spc, bindings = <&kp DOT &kp SPACE &sk LSHFT>; wait-ms = <0>;
          tap-ms = <5>;)

// Tap: backspace | Lshft + tap: delete | Rshft + tap: shift-delete.
ZMK_MOD_MORPH(bs_del, bindings = <&kp BSPC>, <&kp DEL>;
              mods = <(MOD_LSFT|MOD_RSFT)>; keep-mods = <MOD_RSFT>;)

// Tap: copy | double-tap: cut.
ZMK_TAP_DANCE(copy_cut, bindings = <&kp LC(INS)>, <&kp LC(X)>;
              tapping-term-ms = <200>;)
ZMK_TAP_DANCE(ldr, bindings = <&leader>, <&to BASE>;
              tapping-term-ms = <200>;)

// Sticky shift + leader.
ZMK_MACRO(leader_sft, bindings = <&sk LSHFT &leader>;)

// Misc aliases. [TODO: clean up]
#define CANCEL    &kp K_CANCEL            // Cancel caps-word & auto-layers.
#define VOL_DOWN  &hmr RSHFT C_VOL_DN

/* Keymap */

//ZMK_CONDITIONAL_LAYER(sys, FN NUM, SYS) // FN + NUM --> SYS.

#ifndef ZMK_BASE_LAYER
  #define ZMK_BASE_LAYER(name, LT, RT, LM, RM, LB, RB, LH, RH)                 \
      ZMK_LAYER(name, LT RT LM RM LB RB LH RH)
#endif


/* vim: set ft=c tw=146: */

// -----------------------------------------------------------------------------------------
// | TAB     | KP Q       | KP W    | KP E    | KP R     | KP T    | ║ | KP Y     | KP U    | KP I    | KP O    | KP P    | LT BTO |
// | KP ESC  | 🏠GUI|A     | 🏠CTL|S  | 🏠ALT|D  | LT MOT   | KP G    | ║ | KP H     | TEXT|J  | 🏠ALT|K  | 🏠CTL|L  | 🏠GUI|;  | '      |
// | SMARTN  | KP Z       | KP X    | KP C    | KP V     | KP B    | ║ | NUMPD|N  | MEDIA|M | ,       | .       | /       | SWAPPR |
//                     | MAGICS   | MOUSE|SPC | LDR     | LDR     | SYM|ENT | MAGICS |
// -----------------------------------------------------------------------------------------
ZMK_BASE_LAYER(Base,
    &kp TAB   &kp Q       &kp W        &kp E         &kp R        &kp T,       /*|*/ &kp Y       &kp U       &kp I     &kp O        &kp P          &lt BTOOTH BSPC,
    &kp ESC   &hml LGUI A &hml LCTRL S &hml LALT D   &lt MOTION F &kp G,       /*|*/ &kp H       &lt TEXT J  &hmr RALT K &hmr RCTRL L &hmr RGUI SEMI &kp SQT,
    SMART_NUM &kp Z       &kp X        &kp C         &kp V        &kp B,       /*|*/ &lt NUMPD N &lt MEDIA M &kp COMMA &kp DOT      &kp FSLH       &swapper,
                                 MAGIC_SHIFT &lt MOUSE SPACE &ldr,             /*|*/ &ldr        &lt SYM RET MAGIC_SHIFT
)


// -----------------------------------------------------------------------------------------
// | F1     | F2      | F3      | F4      | F5     | F6      | ║ | F7     | F8      | F9      | F10     | F11    | F12    |
// |        | HML LG  | HML LC  | #       | $      | HML LA  | ║ | HMR RA | &       | *       | HMR RC  | HMR RG | \      |
// |        |         | [       | `       | -      | {       | ║ | }      | =       |         | ]       | |      | ~      |
//                     |        |         |         |         |        |        |
// -----------------------------------------------------------------------------------------
// F-keys take the full top row. Tab and Bspc are one hold-release away on Base.
// The thumb row is &trans so the Base thumbs (MAGIC_SHIFT) stay live — without
// that, Shift+F10 would be impossible while SYM is held.
ZMK_BASE_LAYER(Symbol,
    &kp F1   &kp F2         &kp F3        &kp F4         &kp F5    &kp F6,          /*|*/ &kp F7          &kp F8    &kp F9                &kp F10        &kp F11        &kp F12,
    &trans   &hml LGUI EXCL &hml LCTRL AT &kp HASH       &kp DLLR  &hml LALT PRCNT, /*|*/ &hmr RALT CARET &kp AMPS  &kp KP_MULTIPLY       &hmr RCTL LPAR &hmr RGUI RPAR &kp BSLH,
    &trans   &trans         &kp LBKT      &kp GRAVE      &kp MINUS &kp LBRC,        /*|*/ &kp RBRC        &kp EQUAL &trans                &kp RBKT       &kp PIPE       &kp TILDE,
                                          &trans &trans         &trans,            /*|*/ &trans         &trans    &trans
)

// -----------------------------------------------------------------------------------------
// |        | /      | 7      | 8      | 9      | *      | ║ |        |        |        |        |        |        |
// |        | -      | 4      | 5      | 6      | +      | ║ |        |        |        |        |        |        |
// |        |        | 1      | 2      | 3      | 0      | ║ |        | =      |        |        |        |        |
//                     |        |        |        |        |        |        |
// -----------------------------------------------------------------------------------------
ZMK_BASE_LAYER(Numpad,
    &trans &kp KP_DIVIDE &kp N7 &kp N8 &kp N9 &kp KP_MULTIPLY, /*|*/ &trans &trans    &trans &trans &trans &trans,
    &trans &kp MINUS     &kp N4 &kp N5 &kp N6 &kp PLUS,        /*|*/ &trans &trans    &trans &trans &trans &trans,
    &trans &trans        &kp N1 &kp N2 &kp N3 &kp N0,          /*|*/ &trans &kp EQUAL &trans &trans &trans &trans,
                                &trans &trans        &trans,   /*|*/ &trans &trans &trans
)

// -----------------------------------------------------------------------------------------
// |        |        |        |        |        |        | ║ | HOME   | PGDN   | PGUP   | INS    |        | DEL    |
// |        |        |        |        |        |        | ║ | LEFT   | DOWN   | UP     | RIGHT  | END    |        |
// |        |        |        |        |        |        | ║ |        | APP    |        |        |        |        |
//                     |        |        |        |        |        |        |
// -----------------------------------------------------------------------------------------
ZMK_BASE_LAYER(Motion,
    &trans &trans &trans &trans &trans &trans, /*|*/ &kp HOME &kp PG_DN &kp PG_UP &kp INS   &trans  &kp DEL,
    &trans &trans &trans &trans &trans &trans, /*|*/ &kp LEFT &kp DOWN  &kp UP    &kp RIGHT &kp END &trans,
    &trans &trans &trans &trans &trans &trans, /*|*/ &trans   &kp K_APP &trans    &trans    &trans  &trans,
                         &trans &trans &trans, /*|*/ &trans &trans &trans
)

// -----------------------------------------------------------------------------------------
// |        |        |        |        |        |        | ║ |        |        |        |        |        |        |
// |        |        |        |        |        |        | ║ |        |        |        |        |        |        |
// |        |        | CUT    | COPY   | PASTE  |        | ║ |        |        |        |        |        |        |
//                     |        |        |        |        |        |        |
// -----------------------------------------------------------------------------------------
ZMK_BASE_LAYER(Text,
    &trans &trans &trans       &trans        &trans         &trans, /*|*/ &trans &trans &trans &trans &trans &trans,
    &trans &trans &trans       &trans        &trans         &trans, /*|*/ &trans &trans &trans &trans &trans &trans,
    &trans &trans &kp C_AC_CUT &kp C_AC_COPY &kp C_AC_PASTE &trans, /*|*/ &trans &trans &trans &trans &trans &trans,
                               &trans &trans &trans,                /*|*/ &trans        &trans         &trans
)

// -----------------------------------------------------------------------------------------
// |        |        |         |        |         | KP CVO  | ║ | KP CBR |        |        |         | KP CPR |        |
// |        |        | KP CST  |        | KP CPP  | KP CVO  | ║ | KP CBR |        |        |         |        |        |
// |        |        |         |        |         | KP CMU  | ║ | KP CNE |        |        |         |        |        |
//                     |        |        |        |         |        |        |
// -----------------------------------------------------------------------------------------
ZMK_BASE_LAYER(Media,
    &trans &trans &trans     &trans &trans   &kp C_VOL_UP, /*|*/ &kp C_BRI_UP &trans &trans &trans &kp C_PREV &trans,
    &trans &trans &kp C_STOP &trans &kp C_PP &kp C_VOL_DN, /*|*/ &kp C_BRI_DN &trans &trans &trans &trans     &trans,
    &trans &trans &trans     &trans &trans   &kp C_MUTE,   /*|*/ &kp C_NEXT   &trans &trans &trans &trans     &trans,
                             &trans &trans &trans,         /*|*/ &trans &trans   &trans
)

// -----------------------------------------------------------------------------------------
// |        |        |        |        |        |        | ║ |        |        |         |         |         |        |
// | KP F1  | KP F2  | KP F3  | KP F4  | KP F5  | KP F6  | ║ | KP F7  | KP F8  | KP F9   | KP F10  | KP F11  | KP F12 |
// |        |        |        |        |        |        | ║ |        |        |         |         |         |        |
//                     |        |        |         |         |         |        |
// -----------------------------------------------------------------------------------------
ZMK_BASE_LAYER(Function,
    &trans &trans &trans &trans &trans &trans, /*|*/ &trans &trans &trans &trans  &trans  &trans,
    &kp F1 &kp F2 &kp F3 &kp F4 &kp F5 &kp F6, /*|*/ &kp F7 &kp F8 &kp F9 &kp F10 &kp F11 &kp F12,
    &trans &trans &trans &trans &trans &trans, /*|*/ &trans &trans &trans &trans  &trans  &trans,
                         &trans &trans &trans, /*|*/ &trans &trans &trans
)

#ifndef REAL_POINTING_DEVICE
// emulated mouse
// -----------------------------------------------------------------------------------------
// |        |         |        | ↑      |        |        | ║ |         | LT MOU |         |         |        |        |
// |        | LT MOU  | ←      | ↓      | →      |        | ║ | MSC SC  | S↓     | S↑      | MSC SC  | LT MOU |        |
// |        | LT MOU  |        |        |        |        | ║ |         |        |         |         |        |        |
//                     |         |        |         | LCLK    | RCLK   |        |
// -----------------------------------------------------------------------------------------
ZMK_BASE_LAYER(Mouse,
    &trans &trans            &trans         &mmv MOVE_UP   &trans          &trans, /*|*/ &trans         &lt MOUSE_SNIPE A &trans       &trans          &trans           &trans,
    &trans &lt MOUSE_SNIPE A &mmv MOVE_LEFT &mmv MOVE_DOWN &mmv MOVE_RIGHT &trans, /*|*/ &msc SCRL_LEFT &msc SCRL_DOWN    &msc SCRL_UP &msc SCRL_RIGHT &lt MOUSE_HYPR Z &trans,
    &trans &lt MOUSE_HYPR Z  &trans         &trans         &trans          &trans, /*|*/ &trans         &trans            &trans       &trans          &trans           &trans,
                                            &trans &trans            &trans,       /*|*/ &mkp LCLK      &mkp RCLK       &trans
)
// -----------------------------------------------------------------------------------------
// |        |        |        |        |        |        | ║ |        |        |        |        |        |        |
// |        |        |        |        |        |        | ║ |        |        |        |        |        |        |
// |        |        |        |        |        |        | ║ |        |        |        |        |        |        |
//                     |        |        |        |        |        |        |
// -----------------------------------------------------------------------------------------
ZMK_BASE_LAYER(MouseSnipe,
    &trans &trans &trans &trans &trans &trans, /*|*/ &trans &trans &trans &trans &trans &trans,
    &trans &trans &trans &trans &trans &trans, /*|*/ &trans &trans &trans &trans &trans &trans,
    &trans &trans &trans &trans &trans &trans, /*|*/ &trans &trans &trans &trans &trans &trans,
                         &trans &trans &trans, /*|*/ &trans &trans &trans
)
// -----------------------------------------------------------------------------------------
// |        |        |        |        |        |        | ║ |        |        |        |        |        |        |
// |        |        |        |        |        |        | ║ |        |        |        |        |        |        |
// |        |        |        |        |        |        | ║ |        |        |        |        |        |        |
//                     |        |        |        |        |        |        |
// -----------------------------------------------------------------------------------------
ZMK_BASE_LAYER(MouseHypr,
    &trans &trans &trans &trans &trans &trans, /*|*/ &trans &trans &trans &trans &trans &trans,
    &trans &trans &trans &trans &trans &trans, /*|*/ &trans &trans &trans &trans &trans &trans,
    &trans &trans &trans &trans &trans &trans, /*|*/ &trans &trans &trans &trans &trans &trans,
                         &trans &trans &trans, /*|*/ &trans &trans &trans
)
#else
// real pointing device
// -----------------------------------------------------------------------------------------
// |        |         |        |         |        |         | ║ | LCLK   | LCLK   |         |         |        |        |
// |        |         |        |         |        |         | ║ | MSC SC | S↓     | S↑      | MSC SC  | LT MOU |        |
// |        | LT MOU  | RCLK   | MKP MC  | LCLK   | LT MOU  | ║ | LT MOU |        |         |         |        |        |
//                     |        |        |         |         | LCLK   | LCLK   |
// -----------------------------------------------------------------------------------------
ZMK_BASE_LAYER(Mouse,
    &trans &trans            &trans    &trans    &trans    &trans,           /*|*/ &mkp LCLK         &mkp LCLK      &trans       &trans          &trans           &trans,
    &trans &trans            &trans    &trans    &trans    &trans,           /*|*/ &msc SCRL_LEFT    &msc SCRL_DOWN &msc SCRL_UP &msc SCRL_RIGHT &lt MOUSE_HYPR Z &trans,
    &trans &lt MOUSE_SNIPE Z &mkp RCLK &mkp MCLK &mkp LCLK &lt MOUSE_HYPR B, /*|*/ &lt MOUSE_SNIPE N &trans         &trans       &trans          &trans           &trans,
                                       &trans &trans            &trans,      /*|*/ &trans    &mkp LCLK &mkp LCLK
)
// -----------------------------------------------------------------------------------------
// |        |         |        |         |        |         | ║ | LCLK   | LCLK   |         |         |        |        |
// |        |         |        |         |        |         | ║ | MSC SC | S↓     | S↑      | MSC SC  | LT MOU |        |
// |        | LT MOU  | RCLK   | MKP MC  | LCLK   | LT MOU  | ║ | LT MOU |        |         |         |        |        |
//                     |        |        |         |         | LCLK   | LCLK   |
// -----------------------------------------------------------------------------------------
ZMK_BASE_LAYER(MouseSnipe,
    &trans &trans            &trans    &trans    &trans    &trans,           /*|*/ &mkp LCLK         &mkp LCLK      &trans       &trans          &trans           &trans,
    &trans &trans            &trans    &trans    &trans    &trans,           /*|*/ &msc SCRL_LEFT    &msc SCRL_DOWN &msc SCRL_UP &msc SCRL_RIGHT &lt MOUSE_HYPR Z &trans,
    &trans &lt MOUSE_SNIPE Z &mkp RCLK &mkp MCLK &mkp LCLK &lt MOUSE_HYPR B, /*|*/ &lt MOUSE_SNIPE N &trans         &trans       &trans          &trans           &trans,
                                       &trans &trans            &trans,      /*|*/ &trans    &mkp LCLK &mkp LCLK
)
// -----------------------------------------------------------------------------------------
// |        |         |        |         |        |         | ║ | LCLK   | LCLK   |         |         |        |        |
// |        |         |        |         |        |         | ║ | MSC SC | S↓     | S↑      | MSC SC  | LT MOU |        |
// |        | LT MOU  | RCLK   | MKP MC  | LCLK   | LT MOU  | ║ | LT MOU |        |         |         |        |        |
//                     |        |        |         |         | LCLK   | LCLK   |
// -----------------------------------------------------------------------------------------
ZMK_BASE_LAYER(MouseHypr,
    &trans &trans            &trans    &trans    &trans    &trans,           /*|*/ &mkp LCLK         &mkp LCLK      &trans       &trans          &trans           &trans,
    &trans &trans            &trans    &trans    &trans    &trans,           /*|*/ &msc SCRL_LEFT    &msc SCRL_DOWN &msc SCRL_UP &msc SCRL_RIGHT &lt MOUSE_HYPR Z &trans,
    &trans &lt MOUSE_SNIPE Z &mkp RCLK &mkp MCLK &mkp LCLK &lt MOUSE_HYPR B, /*|*/ &lt MOUSE_SNIPE N &trans         &trans       &trans          &trans           &trans,
                                       &trans &trans            &trans,      /*|*/ &trans    &mkp LCLK &mkp LCLK
)
#endif

// -----------------------------------------------------------------------------------------
// | BOOT   | DSC0    | BT BTD  | BT BTD  | BT BTD  | BT BTD  | ║ |        | USB    |        | TOG     | BT BTP | BOOT   |
// | CLR    | BT0     | BT BTS  | BT BTS  | BT BTS  | BT BTS  | ║ |        |        |        |         |        |        |
// | RST    | BT BTD  |         | BT BTC  |         | BLE     | ║ | BT BTN |        |        |         |        | RST    |
//                     |        |        |        |         |        |        |
// -----------------------------------------------------------------------------------------
ZMK_BASE_LAYER(System,
    &bootloader    &bt BT_DISC 0 &bt BT_DISC 1 &bt BT_DISC 2 &bt BT_DISC 3 &bt BT_DISC 4, /*|*/ &trans     &out OUT_USB &trans &out OUT_TOG &bt BT_PRV &bootloader,
    &bt BT_CLR_ALL &bt BT_SEL 0  &bt BT_SEL 1  &bt BT_SEL 2  &bt BT_SEL 3  &bt BT_SEL 4,  /*|*/ &trans     &trans       &trans &trans       &trans     &trans,
    &sys_reset     &bt BT_DISC   &trans        &bt BT_CLR    &trans        &out OUT_BLE,  /*|*/ &bt BT_NXT &trans       &trans &trans       &trans     &sys_reset,
                                               &trans         &trans        &trans,       /*|*/ &trans        &trans        &trans
)
