#include "crosses_shared.dtsi"
#include <dt-bindings/zmk/input_transform.h>
#include <input/processors.dtsi>

#define ZMK_POINTING_DEFAULT_SCRL_VAL 2  // Default is 10; reduce for slower scroll

&spi1 {
    trackball_peripheral@0 {
        spi-max-frequency = <1000000>;
    };
};

&trackball_peripheral_split {
    input-processors = <&zip_xy_to_scroll_mapper>, <&zip_scroll_transform 4>, <&zip_ble_report_rate_limit>;
};

