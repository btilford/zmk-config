#define CONFIG_WIRELESS
// Both trackballs are real hardware, wired up by the board itself — this picks
// the click-oriented Mouse layer from base.keymap over the cursor-emulation one.
#define REAL_POINTING_DEVICE
#define ZMK_BASE_LAYER(name, LT, RT, LM, RM, LB, RB, LH, RH)                   \
    ZMK_LAYER(                                                                 \
        name,                                                                  \
                 LT RT                                                         \
                 LM RM                                                         \
                 LB RB                                                         \
                 LH RH                                                         \
    )

#include <zmk-helpers/key-labels/42.h>

/ {
    chosen {
        // The board defaults to the 54-key layout; select the 42. Its
        // matrix-transform is already attached in crosses_v2.dts, so unlike
        // crosses v1 there is no shifted_transform to define here.
        zmk,physical-layout = &gggw_crosses_42_layout;
    };
};

#include "base.keymap"

/* ---------------------------------------------------------------------------
 * Trackballs.
 *
 * Unlike crosses v1, nothing needs wiring here: crosses_v2.dts already builds
 * both pipelines (&zip_periph_ball on the left, &zip_central_ball on the right)
 * and exposes them through behaviours — &pipe_switch / &pipe_switch_r to pick
 * cursor vs scroll, &dpi_cycle_left / &dpi_cycle_right to cycle CPI. Note the
 * halves are swapped relative to v1: on v2 the *right* half is the split
 * central.
 *
 * base.keymap's snipe/hyper scaling hangs off ZMK's emulated-mouse listeners
 * (&mmv_input_listener / &msc_input_listener), which the real balls do not go
 * through. Per-layer scaling for these balls would attach to the board's
 * listeners instead; left out until the hardware is in hand to tune against.
 * ------------------------------------------------------------------------ */
