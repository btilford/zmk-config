#undef ZMK_LEADER_SEQUENCE
#define ZMK_LEADER_SEQUENCE(name, leader_bindings, leader_sequence) \
    / { \
        behaviors { \
            leader: leader { \
                compatible = "zmk,behavior-leader-key"; \
                #binding-cells = <0>; \
                ignore-keys = <LSHFT RSHFT>; \
                leader_sequence_ ## name { \
                    bindings = <leader_bindings>; \
                    sequence = <leader_sequence>; \
                }; \
            }; \
        }; \
    };


// BLE and USB
#ifdef CONFIG_WIRELESS
ZMK_LEADER_SEQUENCE(usb,        &out OUT_USB,   U S B)
ZMK_LEADER_SEQUENCE(ble,        &out OUT_BLE,   B L E)
#endif // CONFIG_WIRELESS
ZMK_LEADER_SEQUENCE(reset,      &sys_reset,     R E S E T)
ZMK_LEADER_SEQUENCE(boot,       &bootloader,    B O O T)

ZMK_LEADER_SEQUENCE(returnToBaseLayer,  &to BASE,   L B B)
// F1-F12 now live on the SYM top row (hold RH1). This stays as a same-half
// fallback: the leader is on a thumb and F1-F6 are on the left half, so it
// works if the split link is down. See base.keymap's Function layer.
ZMK_LEADER_SEQUENCE(toFnLayer,          &sl FKEYS,  L F)
ZMK_LEADER_SEQUENCE(toBluetooth,        &tog BTOOTH, L B T)
ZMK_LEADER_SEQUENCE(toMouseLayer,      &smart_mouse,  L M S)

// macOS chords. First keys are F/D/W/S; no collision with the U/B/R/L
// sequences above, and no sequence is a prefix of another.
#include "macos.dtsi"

